## boards/shields/slimty32/Kconfig.shield
```kconfig
config SHIELD_SLIMTY32_LEFT
    def_bool $(shields_list_contains,slimty32_left)

config SHIELD_SLIMTY32_RIGHT
    def_bool $(shields_list_contains,slimty32_right)
```
